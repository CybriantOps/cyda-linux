## kernel/cyda/Kconfig
```kconfig
# SPDX-License-Identifier: GPL-2.0-only

config CYDA
	bool "CYDA OS agent-aware kernel interface"
	depends on SYSFS
	default y
	help
	  Exposes CYDA agents (threads named "agent:<id>" by the CYDA
	  runtime) under /sys/kernel/cyda/ and prints the CYDA banner at
	  boot. Foundation for the agent object and the agent-aware
	  scheduling class of CYDA OS.
```

## security/cyda/Kconfig
```kconfig
# SPDX-License-Identifier: GPL-2.0-only
config SECURITY_CYDA
	bool "CYDA OS capability enforcement"
	depends on SECURITY && CYDA
	default y
	help
	  Enforces the capability bitmap of CYDA agents at the syscall
	  boundary: network connects, camera/GPU device access, cgroup
	  writes and scheduler changes are refused for agent threads that
	  lack the corresponding capability. Stacks with other LSMs.
```
